## Project01r/sdkconfig.defaults
```kconfig
############################################
# Flash driver (opsional)
############################################
CONFIG_SPI_FLASH_ROM_DRIVER_PATCH=y


############################################
# Partition table
############################################
CONFIG_PARTITION_TABLE_CUSTOM=y
CONFIG_PARTITION_TABLE_CUSTOM_FILENAME="partitions.csv"
CONFIG_PARTITION_TABLE_OFFSET=0x8000


############################################
# LittleFS (ESP-IDF native)
############################################
CONFIG_LITTLEFS_SUPPORTED=y
CONFIG_LITTLEFS_MAX_PARTITIONS=3

# Parameter low-level LittleFS
CONFIG_LITTLEFS_PAGE_SIZE=256
CONFIG_LITTLEFS_BLOCK_SIZE=2048
CONFIG_LITTLEFS_READ_SIZE=16
CONFIG_LITTLEFS_PROG_SIZE=16
# CONFIG_LITTLEFS_LOOKAHEAD_SIZE=32
# CONFIG_LITTLEFS_CACHE_SIZE=128


############################################
# cJSON (opsional)
############################################
# CONFIG_CJSON_OUTPUT_BUFFER_SIZE=1024
```
